## boards/hydrogreen/lighting_control_unit/board.yml
```yaml
board:
  name: lighting_control_unit
  full_name: Hydrogreen Lighting Control Unit
  vendor: hydrogreen
  socs:
    - name: stm32g491xx
```
